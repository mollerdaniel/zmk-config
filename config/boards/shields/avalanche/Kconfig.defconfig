## config/boards/shields/avalanche/Kconfig.defconfig
```kconfig
if SHIELD_AVALANCHE_LEFT

config ZMK_KEYBOARD_NAME
    default "Avalanche"

config ZMK_SPLIT_BLE_ROLE_CENTRAL
    default y

endif

if SHIELD_AVALANCHE_LEFT || SHIELD_AVALANCHE_RIGHT

config ZMK_SPLIT
    default y
if ZMK_DISPLAY

config I2C
	default y

config SSD1306
	default y

config SSD1306_REVERSE_MODE
	default y

endif # ZMK_DISPLAY

endif
```

## config/west.yml
```yaml
manifest:
  remotes:
    - name: zmkfirmware
      url-base: https://github.com/zmkfirmware
    - name: mollerdaniel
      url-base: https://github.com/mollerdaniel
  self:
    path: config
```
